## drivers/gpio/Kconfig
```kconfig
#
# Copyright (c) 2024 Zach Thomas
#
# SPDX-License-Identifier: Apache-2.0
#

if GPIO

menuconfig GPIO_TLE7230R
	bool "TLE7230R SPI-based relay driver"
	default y
	depends on DT_HAS_INFINEON_TLE7230R_ENABLED
	depends on SPI
	help
	  Enable driver for TLE7230r SPI-based relay driver.

config GPIO_TLE7230R_INIT_PRIORITY
	int "Init priority"
	default 75
	depends on GPIO_TLE7230R
	help
	  Device driver initialization priority.

endif # GPIO
```

## dts/bindings/gpio/infineon,tle7230r.yaml
```yaml
#
# Copyright (c) 2024 Zach Thomas
#
# SPDX-License-Identifier: Apache-2.0
#

description: Infineon TLE7230R relay drriver

compatible: "infineon,tle7230r"

include: [gpio-controller.yaml, spi-device.yaml]

properties:
  "#gpio-cells":
    const: 2

  resn-gpios:
    type: phandle-array
    description: "GPIO for reset"

gpio-cells:
  - pin
  - flags
```
